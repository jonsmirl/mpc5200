## arch/arm/mach-lpc313x/Kconfig
```kconfig
menu "LPC313x Implementations"
	depends on ARCH_LPC313X

choice
	prompt "LPC313x Platform type"
	default MACH_EA313X

config MACH_EA313X
	bool "ea313x board"
	help
	  Say Y here if you are using the Embedded Artist's EA313x board

config MACH_EA3152
	bool "ea3152 board"
	select LPC3152_AD
	help
	  Say Y here if you are using Embedded Artist's EA3152 board
	  
config MACH_VAL3153
	bool "val3153 board"
	help
	  Say Y here if you are using the NXP val3153 board

config MACH_VAL3154
	bool "val3154 board"
	select LPC3152_AD
	help
	  Say Y here if you are using the NXP val3154 board
	  
endchoice

config LPC3152_AD
	bool

source "kernel/Kconfig.hz"

endmenu
```

## drivers/input/ir/Kconfig
```kconfig
#
# LIRC driver(s) configuration
#
menuconfig INPUT_IR
	select CONFIGFS_FS
	tristate "Infrared Remote (IR) receiver/transmitter drivers"
	default n
	help
	  Say Y here, and all supported Infrared Remote Control IR
	  receiver and transmitter drivers will be displayed. The receiver drivers
	  allow control of your Linux system via remote control.

if INPUT_IR

config IR_GPT
	tristate "GPT Based IR Receiver"
	default m
	help
	  Driver for GPT-based IR receiver found on Digispeaker

endif
```

## drivers/input/lirc/Kconfig
```kconfig
#
# LIRC driver(s) configuration
#
menuconfig INPUT_LIRC
	bool "Linux Infrared Remote Control IR receiver/transmitter drivers"
	help
	  Say Y here, and all supported Linux Infrared Remote Control IR and
	  RF receiver and transmitter drivers will be displayed. When paired
	  with a remote control and the lirc daemon, the receiver drivers
	  allow control of your Linux system via remote control.

if INPUT_LIRC

config LIRC_DEV
	tristate "LIRC device loadable module support"
	help
	  LIRC device loadable module support, required for most LIRC drivers

config LIRC_ATIUSB
	tristate "ATI RF USB Receiver support"
	depends on LIRC_DEV && USB
	help
	  Driver for the ATI USB RF remote receiver

config LIRC_BT829
        tristate "BT829 based hardware"
	depends on LIRC_DEV
	help
	  Driver for the IR interface on BT829-based hardware

config LIRC_I2C
	tristate "I2C Based IR Receivers"
	depends on LIRC_DEV
	help
	  Driver for I2C-based IR receivers, such as those commonly
	  found onboard Hauppauge PVR-150/250/350 video capture cards

config LIRC_IGORPLUGUSB
	tristate "Igor Cesko's USB IR Receiver"
	depends on LIRC_DEV && USB
	help
	  Driver for Igor Cesko's USB IR Receiver

config LIRC_IMON
	tristate "Soundgraph IMON Receiver"
	depends on LIRC_DEV
	help
	  Driver for the Soundgraph IMON IR Receiver

config LIRC_IT87
	tristate "ITE IT87XX CIR Port Receiver"
	depends on LIRC_DEV
	help
	  Driver for the ITE IT87xx IR Receiver

config LIRC_ITE8709
	tristate "ITE8709 CIR Port Receiver"
	depends on LIRC_DEV && PNP
	help
	  Driver for the ITE8709 IR Receiver

config LIRC_MCEUSB
	tristate "Microsoft Media Center Ed. Receiver, v1"
	depends on LIRC_DEV && USB
	help
	  Driver for the Microsoft Media Center Ed. Receiver, v1

config LIRC_MCEUSB2
	tristate "Microsoft Media Center Ed. Receiver, v2"
	depends on LIRC_DEV && USB
	help
	  Driver for the Microsoft Media Center Ed. Receiver, v2

config LIRC_PARALLEL
	tristate "Homebrew Parallel Port Receiver"
	depends on LIRC_DEV && !SMP
	help
	  Driver for Homebrew Parallel Port Receivers

config LIRC_SASEM
	tristate "Sasem USB IR Remote"
	depends on LIRC_DEV
	help
	  Driver for the Sasem OnAir Remocon-V or Dign HV5 HTPC IR/VFD Module

config LIRC_SERIAL
	tristate "Homebrew Serial Port Receiver"
	depends on LIRC_DEV
	help
	  Driver for Homebrew Serial Port Receivers

config LIRC_SERIAL_TRANSMITTER
	bool "Serial Port Transmitter"
	default y
	depends on LIRC_SERIAL
	help
	  Serial Port Transmitter support

config LIRC_SIR
	tristate "Built-in SIR IrDA port"
	depends on LIRC_DEV
	help
	  Driver for the SIR IrDA port

config LIRC_STREAMZAP
	tristate "Streamzap PC Receiver"
	depends on LIRC_DEV
	help
	  Driver for the Streamzap PC Receiver

config LIRC_TTUSBIR
	tristate "Technotrend USB IR Receiver"
	depends on LIRC_DEV && USB
	help
	  Driver for the Technotrend USB IR Receiver

config LIRC_ZILOG
	tristate "Zilog/Hauppauge IR Transmitter"
	depends on LIRC_DEV
	help
	  Driver for the Zilog/Hauppauge IR Transmitter, found on
	  PVR-150/500, HVR-1200/1250/1700/1800, HD-PVR and other cards

endif
```

## drivers/of/Kconfig
```kconfig
config OF_DEVICE
	def_bool y
	depends on OF && (SPARC || PPC_OF)

config OF_GPIO
	def_bool y
	depends on OF && PPC_OF && GPIOLIB
	help
	  OpenFirmware GPIO accessors

config OF_I2C
	def_tristate I2C
	depends on PPC_OF && I2C
	help
	  OpenFirmware I2C accessors

config OF_SPI
	def_tristate SPI
	depends on OF && PPC_OF && SPI
	help
	  OpenFirmware SPI accessors

config OF_MMC_SPI
	bool "OpenFirmware bindings for MMC/SD over SPI"
	depends on PPC_OF && SPI
	default y if MMC_SPI
	help
	  Say Y here to enable OpenFirmware bindings for the MMC/SD over SPI
	  driver.
```

## sound/soc/codecs/Kconfig
```kconfig
config SND_SOC_AC97_CODEC
	tristate
	depends on SND_SOC

config SND_SOC_AD1939
	tristate
	depends on SND_SOC

config SND_SOC_AK4535
	tristate
	depends on SND_SOC

config SND_SOC_TLV320
	tristate
	depends on SND_SOC

config SND_SOC_UDA1380
	tristate
	depends on SND_SOC

config SND_SOC_WM8350
	tristate
	depends on SND_SOC

config SND_SOC_WM8510
	tristate
	depends on SND_SOC

config SND_SOC_WM8711
	tristate
	depends on SND_SOC

config SND_SOC_WM8731
	tristate
	depends on SND_SOC

config SND_SOC_WM8750
	tristate
	depends on SND_SOC

config SND_SOC_WM8753
	tristate
	depends on SND_SOC

config SND_SOC_WM8772
	tristate
	depends on SND_SOC
	
config SND_SOC_WM8950
	tristate
	depends on SND_SOC

config SND_SOC_WM8956
	tristate
	depends on SND_SOC

config SND_SOC_WM8960
	tristate
	depends on SND_SOC

config SND_SOC_WM8971
	tristate
	depends on SND_SOC

config SND_SOC_WM8974
	tristate
	depends on SND_SOC

config SND_SOC_WM8976
	tristate
	depends on SND_SOC

config SND_SOC_WM8980
	tristate
	depends on SND_SOC

config SND_SOC_WM9712
	tristate
	depends on SND_SOC

config SND_SOC_WM9713
	tristate
	depends on SND_SOC

# Cirrus Logic CS4270 Codec
config SND_SOC_CS4270
	tristate
	depends on SND_SOC && I2C

# Cirrus Logic CS4270 Codec Hardware Mute Support
# Select if you have external muting circuitry attached to your CS4270.
config SND_SOC_CS4270_HWMUTE
	bool
	depends on SND_SOC_CS4270

# Cirrus Logic CS4270 Codec VD = 3.3V Errata
# Select if you are affected by the errata where the part will not function
# if MCLK divide-by-1.5 is selected and VD is set to 3.3V.  The driver will
# not select any sample rates that require MCLK to be divided by 1.5.
config SND_SOC_CS4270_VD33_ERRATA
	bool
	depends on SND_SOC_CS4270

config SND_SOC_TLV320AIC3X
	tristate
	depends on SND_SOC && I2C
```

## sound/soc/fsl/Kconfig
```kconfig
config SND_SOC_OF_SIMPLE
	tristate

config SND_MPC52xx_SOC
	tristate "SoC Audio for the Freescale MPC5200 chip"
	depends on PPC_MPC52xx && SND_SOC
	help
	  Say Y or M if you want to add support for codecs attached to
	  the MPC5200 AC97 or I2S interface. You will also need
	  to select the audio interfaces to support below.

config SND_MPC52xx_AC97
	tristate
	select SND_AC97_CODEC

config SND_MPC52xx_SOC_AC97
	tristate
	select AC97_BUS
	select SND_SOC_AC97_BUS

config SND_SOC_MPC8610
	bool "ALSA SoC support for the MPC8610 SOC"
	depends on MPC8610_HPCD
	default y if MPC8610
	help
	  Say Y if you want to add support for codecs attached to the SSI
          device on an MPC8610.

config SND_SOC_MPC8610_HPCD
	bool "ALSA SoC support for the Freescale MPC8610 HPCD board"
	depends on SND_SOC_MPC8610
	select SND_SOC_CS4270
	select SND_SOC_CS4270_VD33_ERRATA
	default y if MPC8610_HPCD
	help
	  Say Y if you want to enable audio on the Freescale MPC8610 HPCD.

config SND_SOC_MPC5200_I2S
	tristate "Freescale MPC5200 PSC in I2S mode driver"
	depends on PPC_MPC52xx && PPC_BESTCOMM
	select SND_SOC_OF_SIMPLE
	select PPC_BESTCOMM_GEN_BD
	help
	  Say Y here to support the MPC5200 PSCs in I2S mode.

config SND_MPC52xx_SOC_EFIKA
	tristate "SoC AC97 Audio support for bbplan Efika and STAC9722"
	depends on SND_MPC52xx_SOC && PPC_EFIKA
	select SND_MPC52xx_SOC_AC97
	select SND_SOC_STAC9766
	help
	  Say Y if you want to add support for sound on the Efika.

config SND_MPC52xx_SOC_DSPEAK01
	tristate "SoC I2S Audio support for Digispeaker DSPEAK01 with TAS5504"
	depends on SND_MPC52xx_SOC && PPC_DSPEAK01
	select SND_SOC_MPC5200_I2S
	select SND_SOC_TAS5504
	help
	  Say Y if you want to add support for sound on Digispeaker DSPEAK01.
```

## sound/soc/imx/Kconfig
```kconfig
config SND_MXC_SOC
	tristate "SoC Audio for the Freescale i.MX CPU"
	depends on ARCH_MXC && SND
	select SND_PCM
	help
	  Say Y or M if you want to add support for codecs attached to
	  the MXC AC97, I2S or SSP interface. You will also need
	  to select the audio interfaces to support below.

config SND_MXC_AC97
	tristate
	select SND_AC97_CODEC

config SND_MXC_SOC_AC97
	tristate
	select AC97_BUS

config SND_MXC_SOC_SSI
	tristate

config SND_SOC_IMX31ADS_WM8753
	tristate "SoC Audio support for MX31 - WM8753"
	depends on SND_MXC_SOC && ARCH_MX3
	select SND_MXC_SOC_SSI
	select SND_SOC_WM8753
	help
	  Say Y if you want to add support for SoC audio on MX31ADS
	  with the WM8753.

config SND_SOC_IMX32ADS_WM8350
	tristate "SoC Audio support for MX31 - WM8350"
	depends on SND_MXC_SOC && ARCH_MX3 && REGULATOR_WM8350
	select SND_MXC_SOC_SSI
	select SND_SOC_WM8350
	select SND_MXC_SOC_SSI
	help
	  Say Y if you want to add support for SoC audio on MX32ADS
	  with the WM8350.
```

## sound/soc/lpc313x/Kconfig
```kconfig
config SND_LPC313X_SOC
        tristate "SoC Audio for the NXP LPC313X System-on-a-Chip"
				depends on ARCH_LPC313X && SND_SOC && MACH_EA313X
        help
          Say Y or M if you want to add audio support for the LPC313X.
          You will also need to to select the audio interfaces to
	  support below.

config SND_LPC315X_SOC
	tristate "SoC Audio for the NXP LPC315X System-on-a-Chip"
	depends on ARCH_LPC313X && SND_SOC && MACH_EA3152
	help
	Say Y or M if you want to add audio support for the LPC313X.
	You will also need to to select the audio interfaces to
	support below.

config SND_LPC313X_SOC_I2S
        bool

config SND_LPC313X_SOC_I2S_UDA1380
        bool "SoC Audio for the UDA1380 CODEC using I2S/I2C"
        depends on SND_LPC313X_SOC
        select I2C_PNX
        select SND_LPC313X_SOC_I2S
        select SND_SOC_UDA1380
        help
          Say Y here if you want to add support for SoC audio on the
	  LPC313x with the UDA1380 CODEC. This requires an I2S channel
	  and I2C channel connected to the I2C interface of the
	  UDA1380 codec.

config SND_LPC315X_SOC_I2S_LPC315X_CODEC
	bool "SoC Audio for the Analog Die CODEC using I2S/I2C in 315X SoC"
	depends on SND_LPC315X_SOC
	select I2C_PNX
	select SND_LPC313X_SOC_I2S
	select SND_SOC_LPC315X_CODEC
	help
		Say Y here if you want to add support for SoC audio on the
		LPC315x with the Analog Die CODEC. This requires an I2S channel
		and I2C channel connected to the I2C interface of the
		Analog Die CODEC.

config SND_USE_EA3131
        bool "Enable audio configuration for the EA3131 board"
        depends on SND_LPC313X_SOC
	select SND_LPC313X_SOC_I2S_UDA1380
	select SND_I2C1_CHANNEL_UDA1380
	select SND_I2S_RX1_MASTER
	select SND_I2S_TX1_MASTER
	select SND_CODEC_FS256
        help
          Say Y to configuration audio for the EA3131 board. The EA3131
	  board used the I2S1 channel with the UDA1380 audio CODEC and
	  I2C on channel 1.

config SND_USE_EA3152
	bool "Enable audio configuration for the EA3152 board"
	depends on SND_LPC315X_SOC
	select SND_LPC315X_SOC_I2S_LPC315X_CODEC
	select SND_I2C1_CHANNEL_LPC315X_CODEC
	select SND_I2S_RX1_MASTER
	select SND_I2S_TX1_MASTER
	select SND_CODEC_FS128
	help
		Say Y to configuration audio for the EA3152 board. The EA3152
		board uses the I2S1 channel with the Analog Die audio CODEC and
		I2C on channel 1.

config SND_I2C1_CHANNEL_UDA1380
	bool "I2C1 channel connected to the UDA1380"
	depends on SND_LPC313X_SOC_I2S_UDA1380
	help
	  Say Y here to use the I2C1 channel to communicate with the
	  UDA1380 CODEC. Not selecting this option will use I2C0.

config SND_I2C1_CHANNEL_LPC315X_CODEC
	bool "I2C1 channel connected to the Analog Die Audio CODEC"
	depends on SND_LPC315X_SOC_I2S_LPC315X_CODEC
	help
	  Say Y here to use the I2C1 channel to communicate with the
	  Analog Die Audio CODEC. Not selecting this option will use I2C0.

choice
	prompt "I2S RX channel configuration"
	depends on SND_LPC313X_SOC_I2S
	help
	  This menu selects the I2S RX (record) channel configurations

	config SND_I2S_RX0_MASTER
	bool "I2S RX0 master mode"
	help
	  Select this option to only used the I2S RX0 channel for
	  audio record in master mode.

	config SND_I2S_RX1_MASTER
	bool "I2S RX1 master mode"
	help
	  Select this option to only used the I2S RX1 channel for
	  audio record in master mode.

	config SND_I2S_RX0_SLAVE
	bool "I2S RX0 slave mode"
	help
	  Select this option to only used the I2S RX0 channel for
	  audio record in slave mode.

	config SND_I2S_RX1_SLAVE
	bool "I2S RX1 slave mode"
	help
	  Select this option to only used the I2S RX1 channel for
	  audio record in slave mode.

endchoice

choice
	prompt "I2S TX channel configuration"
	depends on SND_LPC313X_SOC_I2S
	help
	  This menu selects the I2S TX (playback) channel configurations

	config SND_I2S_TX0_MASTER
	bool "I2S TX0 master mode"
	help
	  Select this option to only used the I2S TX0 channel for
	  audio playback in master mode.

	config SND_I2S_TX1_MASTER
	bool "I2S TX1 master mode"
	help
	  Select this option to only used the I2S TX1 channel for
	  audio record in playback mode.

endchoice

choice
	prompt "WS clock divider"
	depends on SND_LPC313X_SOC_I2S && SND_LPC313X_SOC
	help
	  This divider is used to generate the WS rate from the CODEC
	  clock. The CODEC clock may or may not be generated by the LPC313x.
	  If it is, it is generated on the CLK_256FS pin. This divider is
	  usually a factor of 256, 384, 512, 768, or 1024 times the sample
	  frequency. Selected the correct multiplier here to have the audio
	  driver generate the correct clock rates for the audio CODEC.

	config SND_CODEC_FS256
	bool "CODEC clock is 256FS"

	config SND_CODEC_FS384
	bool "CODEC clock is 384FS"

	config SND_CODEC_FS512
	bool "CODEC clock is 512FS"

	config SND_CODEC_FS768
	bool "CODEC clock is 768FS"

	config SND_CODEC_FS1024
	bool "CODEC clock is 1024FS"

endchoice

choice
	prompt "WS clock divider"
	depends on SND_LPC313X_SOC_I2S && SND_LPC315X_SOC
	help
	  This divider is used to generate the WS rate from the CODEC
	  clock. The CODEC clock is generated by LPC315x digital Die.
	  It is generated on the CLK_256FS pin. This divider is
	  usually a factor of 128 times the sample frequency.
	  Selected the correct multiplier here to have the audio
	  driver generate the correct clock rates for the audio CODEC.

	config SND_CODEC_FS128
	bool "CODEC clock is 128FS"

endchoice

config SND_CODEC_NO_FS256_NEEDED
        bool "Disable the CLK_FS256 signals"
				depends on SND_LPC313X_SOC || SND_LPC315X_SOC
        help
          For audio CODECs that do not need the FS256 clock, enable this
	  option. These CODECs usually generate internal clocking based
	  on the BCK and ES signals from the LPC313X I2S signals.

config SND_USE_DMA_LINKLIST
        bool "Use a DMA linked list instead of a circular buffer"
	default y
				depends on SND_LPC313X_SOC || SND_LPC315X_SOC
        help
          The audio driver supports 2 DMA mode: circular buffer mode and
	  DMA linked list mode. This option lets you choose which mode to
	  use. DMA linked list mode is recommended.
```
